## test/Kconfig/soc/Kconfig.defconfig
```kconfig
# Load Zephyr SoC defconfig descriptions.
osource "E:/Code_Projects/zephyr/soc/xlnx/zynqmp/Kconfig.defconfig"
osource "E:/Code_Projects/zephyr/soc/xlnx/zynq7000/Kconfig.defconfig"
osource "E:/Code_Projects/zephyr/soc/xlnx/versalnet/Kconfig.defconfig"
osource "E:/Code_Projects/zephyr/soc/xlnx/versal2/Kconfig.defconfig"
osource "E:/Code_Projects/zephyr/soc/xen/Kconfig.defconfig"
osource "E:/Code_Projects/zephyr/soc/wch/ch32v/Kconfig.defconfig"
osource "E:/Code_Projects/zephyr/soc/ti/simplelink/Kconfig.defconfig"
osource "E:/Code_Projects/zephyr/soc/ti/mspm0/Kconfig.defconfig"
osource "E:/Code_Projects/zephyr/soc/ti/lm3s6965/Kconfig.defconfig"
osource "E:/Code_Projects/zephyr/soc/ti/k3/Kconfig.defconfig"
osource "E:/Code_Projects/zephyr/soc/telink/tlsr/Kconfig.defconfig"
osource "E:/Code_Projects/zephyr/soc/starfive/jh71xx/Kconfig.defconfig"
osource "E:/Code_Projects/zephyr/soc/st/stm32/Kconfig.defconfig"
osource "E:/Code_Projects/zephyr/soc/snps/qemu_arc/Kconfig.defconfig"
osource "E:/Code_Projects/zephyr/soc/snps/nsim/arc_v/Kconfig.defconfig"
osource "E:/Code_Projects/zephyr/soc/snps/nsim/arc_classic/Kconfig.defconfig"
osource "E:/Code_Projects/zephyr/soc/snps/hsdk4xd/Kconfig.defconfig"
osource "E:/Code_Projects/zephyr/soc/snps/hsdk/Kconfig.defconfig"
osource "E:/Code_Projects/zephyr/soc/snps/emsk/Kconfig.defconfig"
osource "E:/Code_Projects/zephyr/soc/snps/emsdp/Kconfig.defconfig"
osource "E:/Code_Projects/zephyr/soc/snps/arc_iot/Kconfig.defconfig"
osource "E:/Code_Projects/zephyr/soc/silabs/Kconfig.defconfig"
osource "E:/Code_Projects/zephyr/soc/sifive/sifive_freedom/Kconfig.defconfig"
osource "E:/Code_Projects/zephyr/soc/sensry/Kconfig.defconfig"
osource "E:/Code_Projects/zephyr/soc/rockchip/Kconfig.defconfig"
osource "E:/Code_Projects/zephyr/soc/renode/riscv_virtual/Kconfig.defconfig"
osource "E:/Code_Projects/zephyr/soc/renode/cortex_r8_virtual/Kconfig.defconfig"
osource "E:/Code_Projects/zephyr/soc/renesas/smartbond/Kconfig.defconfig"
osource "E:/Code_Projects/zephyr/soc/renesas/rz/Kconfig.defconfig"
osource "E:/Code_Projects/zephyr/soc/renesas/rx/Kconfig.defconfig"
osource "E:/Code_Projects/zephyr/soc/renesas/rcar/Kconfig.defconfig"
osource "E:/Code_Projects/zephyr/soc/renesas/ra/Kconfig.defconfig"
osource "E:/Code_Projects/zephyr/soc/realtek/ec/Kconfig.defconfig"
osource "E:/Code_Projects/zephyr/soc/raspberrypi/rpi_pico/Kconfig.defconfig"
osource "E:/Code_Projects/zephyr/soc/quicklogic/eos_s3/Kconfig.defconfig"
osource "E:/Code_Projects/zephyr/soc/qemu/virt_riscv/Kconfig.defconfig"
osource "E:/Code_Projects/zephyr/soc/qemu/malta/Kconfig.defconfig"
osource "E:/Code_Projects/zephyr/soc/openisa/rv32m1/Kconfig.defconfig"
osource "E:/Code_Projects/zephyr/soc/openhwgroup/cva6/Kconfig.defconfig"
osource "E:/Code_Projects/zephyr/soc/oct/osd32mp15x/Kconfig.defconfig"
osource "E:/Code_Projects/zephyr/soc/nxp/s32/Kconfig.defconfig"
osource "E:/Code_Projects/zephyr/soc/nxp/rw/Kconfig.defconfig"
osource "E:/Code_Projects/zephyr/soc/nxp/mcx/Kconfig.defconfig"
osource "E:/Code_Projects/zephyr/soc/nxp/lpc/Kconfig.defconfig"
osource "E:/Code_Projects/zephyr/soc/nxp/layerscape/Kconfig.defconfig"
osource "E:/Code_Projects/zephyr/soc/nxp/kinetis/Kconfig.defconfig"
osource "E:/Code_Projects/zephyr/soc/nxp/imxrt/Kconfig.defconfig"
osource "E:/Code_Projects/zephyr/soc/nxp/imx/Kconfig.defconfig"
osource "E:/Code_Projects/zephyr/soc/nuvoton/numicro/Kconfig.defconfig"
osource "E:/Code_Projects/zephyr/soc/nuvoton/numaker/Kconfig.defconfig"
osource "E:/Code_Projects/zephyr/soc/nuvoton/npcx/Kconfig.defconfig"
osource "E:/Code_Projects/zephyr/soc/nuvoton/npcm/Kconfig.defconfig"
osource "E:/Code_Projects/zephyr/soc/nordic/Kconfig.defconfig"
osource "E:/Code_Projects/zephyr/soc/neorv32/Kconfig.defconfig"
osource "E:/Code_Projects/zephyr/soc/native/inf_clock/Kconfig.defconfig"
osource "E:/Code_Projects/zephyr/soc/microchip/sam/Kconfig.defconfig"
osource "E:/Code_Projects/zephyr/soc/microchip/miv/Kconfig.defconfig"
osource "E:/Code_Projects/zephyr/soc/microchip/mec/Kconfig.defconfig"
osource "E:/Code_Projects/zephyr/soc/mediatek/mt8xxx/Kconfig.defconfig"
osource "E:/Code_Projects/zephyr/soc/lowrisc/opentitan/Kconfig.defconfig"
osource "E:/Code_Projects/zephyr/soc/litex/litex_vexriscv/Kconfig.defconfig"
osource "E:/Code_Projects/zephyr/soc/ite/ec/Kconfig.defconfig"
osource "E:/Code_Projects/zephyr/soc/intel/raptor_lake/Kconfig.defconfig"
osource "E:/Code_Projects/zephyr/soc/intel/lakemont/Kconfig.defconfig"
osource "E:/Code_Projects/zephyr/soc/intel/intel_socfpga_std/Kconfig.defconfig"
osource "E:/Code_Projects/zephyr/soc/intel/intel_socfpga/Kconfig.defconfig"
osource "E:/Code_Projects/zephyr/soc/intel/intel_niosv/Kconfig.defconfig"
osource "E:/Code_Projects/zephyr/soc/intel/intel_ish/Kconfig.defconfig"
osource "E:/Code_Projects/zephyr/soc/intel/intel_adsp/Kconfig.defconfig"
osource "E:/Code_Projects/zephyr/soc/intel/elkhart_lake/Kconfig.defconfig"
osource "E:/Code_Projects/zephyr/soc/intel/atom/Kconfig.defconfig"
osource "E:/Code_Projects/zephyr/soc/intel/apollo_lake/Kconfig.defconfig"
osource "E:/Code_Projects/zephyr/soc/intel/alder_lake/Kconfig.defconfig"
osource "E:/Code_Projects/zephyr/soc/infineon/cat3/Kconfig.defconfig"
osource "E:/Code_Projects/zephyr/soc/infineon/cat1c/Kconfig.defconfig"
osource "E:/Code_Projects/zephyr/soc/infineon/cat1b/Kconfig.defconfig"
osource "E:/Code_Projects/zephyr/soc/infineon/cat1a/Kconfig.defconfig"
osource "E:/Code_Projects/zephyr/soc/gd/gd32/Kconfig.defconfig"
osource "E:/Code_Projects/zephyr/soc/gaisler/leon3/Kconfig.defconfig"
osource "E:/Code_Projects/zephyr/soc/gaisler/gr716a/Kconfig.defconfig"
osource "E:/Code_Projects/zephyr/soc/espressif/Kconfig.defconfig"
osource "E:/Code_Projects/zephyr/soc/ene/kb1200/Kconfig.defconfig"
osource "E:/Code_Projects/zephyr/soc/efinix/sapphire/Kconfig.defconfig"
osource "E:/Code_Projects/zephyr/soc/cdns/xtensa_sample_controller/Kconfig.defconfig"
osource "E:/Code_Projects/zephyr/soc/cdns/sample_controller32/Kconfig.defconfig"
osource "E:/Code_Projects/zephyr/soc/cdns/dc233c/Kconfig.defconfig"
osource "E:/Code_Projects/zephyr/soc/brcm/bcmvk/Kconfig.defconfig"
osource "E:/Code_Projects/zephyr/soc/brcm/bcm2712/Kconfig.defconfig"
osource "E:/Code_Projects/zephyr/soc/brcm/bcm2711/Kconfig.defconfig"
osource "E:/Code_Projects/zephyr/soc/bflb/Kconfig.defconfig"
osource "E:/Code_Projects/zephyr/soc/atmel/sam0/Kconfig.defconfig"
osource "E:/Code_Projects/zephyr/soc/atmel/sam/Kconfig.defconfig"
osource "E:/Code_Projects/zephyr/soc/aspeed/Kconfig.defconfig"
osource "E:/Code_Projects/zephyr/soc/arm/Kconfig.defconfig"
osource "E:/Code_Projects/zephyr/soc/arm/beetle/Kconfig.defconfig"
osource "E:/Code_Projects/zephyr/soc/antmicro/myra/Kconfig.defconfig"
osource "E:/Code_Projects/zephyr/soc/andestech/Kconfig.defconfig"
osource "E:/Code_Projects/zephyr/soc/amd/acp_6_0/Kconfig.defconfig"
osource "E:/Code_Projects/zephyr/soc/ambiq/Kconfig.defconfig"
osource "E:/Code_Projects/zephyr/soc/aesc/Kconfig.defconfig"
osource "E:/Code_Projects/zephyr/soc/adi/max32/Kconfig.defconfig"
osource "E:/Code_Projects/nrf/soc/sercomm/nrf91/Kconfig.defconfig"
osource "E:/Code_Projects/nrf/soc/nordic/Kconfig.defconfig"
```

## test/SlimeVR-Tracker-nRF-52833/Kconfig/Kconfig.shield.defconfig
```kconfig
osource "E:/Code_Projects/SlimeVR-Tracker-nRF-52833/boards/shields/*/Kconfig.defconfig"
osource "E:/Code_Projects/nrf/boards/shields/*/Kconfig.defconfig"
```

## test/SlimeVR-Tracker-nRF-52833/Kconfig/soc/Kconfig.sysbuild
```kconfig
# Load Sysbuild SoC Kconfig descriptions.
osource "E:/Code_Projects/zephyr/soc/xlnx/zynqmp/Kconfig.sysbuild"
osource "E:/Code_Projects/zephyr/soc/xlnx/zynq7000/Kconfig.sysbuild"
osource "E:/Code_Projects/zephyr/soc/xlnx/versalnet/Kconfig.sysbuild"
osource "E:/Code_Projects/zephyr/soc/xlnx/versal2/Kconfig.sysbuild"
osource "E:/Code_Projects/zephyr/soc/xen/Kconfig.sysbuild"
osource "E:/Code_Projects/zephyr/soc/wch/ch32v/Kconfig.sysbuild"
osource "E:/Code_Projects/zephyr/soc/ti/simplelink/Kconfig.sysbuild"
osource "E:/Code_Projects/zephyr/soc/ti/mspm0/Kconfig.sysbuild"
osource "E:/Code_Projects/zephyr/soc/ti/lm3s6965/Kconfig.sysbuild"
osource "E:/Code_Projects/zephyr/soc/ti/k3/Kconfig.sysbuild"
osource "E:/Code_Projects/zephyr/soc/telink/tlsr/Kconfig.sysbuild"
osource "E:/Code_Projects/zephyr/soc/starfive/jh71xx/Kconfig.sysbuild"
osource "E:/Code_Projects/zephyr/soc/st/stm32/Kconfig.sysbuild"
osource "E:/Code_Projects/zephyr/soc/snps/qemu_arc/Kconfig.sysbuild"
osource "E:/Code_Projects/zephyr/soc/snps/nsim/arc_v/Kconfig.sysbuild"
osource "E:/Code_Projects/zephyr/soc/snps/nsim/arc_classic/Kconfig.sysbuild"
osource "E:/Code_Projects/zephyr/soc/snps/hsdk4xd/Kconfig.sysbuild"
osource "E:/Code_Projects/zephyr/soc/snps/hsdk/Kconfig.sysbuild"
osource "E:/Code_Projects/zephyr/soc/snps/emsk/Kconfig.sysbuild"
osource "E:/Code_Projects/zephyr/soc/snps/emsdp/Kconfig.sysbuild"
osource "E:/Code_Projects/zephyr/soc/snps/arc_iot/Kconfig.sysbuild"
osource "E:/Code_Projects/zephyr/soc/silabs/Kconfig.sysbuild"
osource "E:/Code_Projects/zephyr/soc/sifive/sifive_freedom/Kconfig.sysbuild"
osource "E:/Code_Projects/zephyr/soc/sensry/Kconfig.sysbuild"
osource "E:/Code_Projects/zephyr/soc/rockchip/Kconfig.sysbuild"
osource "E:/Code_Projects/zephyr/soc/renode/riscv_virtual/Kconfig.sysbuild"
osource "E:/Code_Projects/zephyr/soc/renode/cortex_r8_virtual/Kconfig.sysbuild"
osource "E:/Code_Projects/zephyr/soc/renesas/smartbond/Kconfig.sysbuild"
osource "E:/Code_Projects/zephyr/soc/renesas/rz/Kconfig.sysbuild"
osource "E:/Code_Projects/zephyr/soc/renesas/rx/Kconfig.sysbuild"
osource "E:/Code_Projects/zephyr/soc/renesas/rcar/Kconfig.sysbuild"
osource "E:/Code_Projects/zephyr/soc/renesas/ra/Kconfig.sysbuild"
osource "E:/Code_Projects/zephyr/soc/realtek/ec/Kconfig.sysbuild"
osource "E:/Code_Projects/zephyr/soc/raspberrypi/rpi_pico/Kconfig.sysbuild"
osource "E:/Code_Projects/zephyr/soc/quicklogic/eos_s3/Kconfig.sysbuild"
osource "E:/Code_Projects/zephyr/soc/qemu/virt_riscv/Kconfig.sysbuild"
osource "E:/Code_Projects/zephyr/soc/qemu/malta/Kconfig.sysbuild"
osource "E:/Code_Projects/zephyr/soc/openisa/rv32m1/Kconfig.sysbuild"
osource "E:/Code_Projects/zephyr/soc/openhwgroup/cva6/Kconfig.sysbuild"
osource "E:/Code_Projects/zephyr/soc/oct/osd32mp15x/Kconfig.sysbuild"
osource "E:/Code_Projects/zephyr/soc/nxp/s32/Kconfig.sysbuild"
osource "E:/Code_Projects/zephyr/soc/nxp/rw/Kconfig.sysbuild"
osource "E:/Code_Projects/zephyr/soc/nxp/mcx/Kconfig.sysbuild"
osource "E:/Code_Projects/zephyr/soc/nxp/lpc/Kconfig.sysbuild"
osource "E:/Code_Projects/zephyr/soc/nxp/layerscape/Kconfig.sysbuild"
osource "E:/Code_Projects/zephyr/soc/nxp/kinetis/Kconfig.sysbuild"
osource "E:/Code_Projects/zephyr/soc/nxp/imxrt/Kconfig.sysbuild"
osource "E:/Code_Projects/zephyr/soc/nxp/imx/Kconfig.sysbuild"
osource "E:/Code_Projects/zephyr/soc/nuvoton/numicro/Kconfig.sysbuild"
osource "E:/Code_Projects/zephyr/soc/nuvoton/numaker/Kconfig.sysbuild"
osource "E:/Code_Projects/zephyr/soc/nuvoton/npcx/Kconfig.sysbuild"
osource "E:/Code_Projects/zephyr/soc/nuvoton/npcm/Kconfig.sysbuild"
osource "E:/Code_Projects/zephyr/soc/nordic/Kconfig.sysbuild"
osource "E:/Code_Projects/zephyr/soc/neorv32/Kconfig.sysbuild"
osource "E:/Code_Projects/zephyr/soc/native/inf_clock/Kconfig.sysbuild"
osource "E:/Code_Projects/zephyr/soc/microchip/sam/Kconfig.sysbuild"
osource "E:/Code_Projects/zephyr/soc/microchip/miv/Kconfig.sysbuild"
osource "E:/Code_Projects/zephyr/soc/microchip/mec/Kconfig.sysbuild"
osource "E:/Code_Projects/zephyr/soc/mediatek/mt8xxx/Kconfig.sysbuild"
osource "E:/Code_Projects/zephyr/soc/lowrisc/opentitan/Kconfig.sysbuild"
osource "E:/Code_Projects/zephyr/soc/litex/litex_vexriscv/Kconfig.sysbuild"
osource "E:/Code_Projects/zephyr/soc/ite/ec/Kconfig.sysbuild"
osource "E:/Code_Projects/zephyr/soc/intel/raptor_lake/Kconfig.sysbuild"
osource "E:/Code_Projects/zephyr/soc/intel/lakemont/Kconfig.sysbuild"
osource "E:/Code_Projects/zephyr/soc/intel/intel_socfpga_std/Kconfig.sysbuild"
osource "E:/Code_Projects/zephyr/soc/intel/intel_socfpga/Kconfig.sysbuild"
osource "E:/Code_Projects/zephyr/soc/intel/intel_niosv/Kconfig.sysbuild"
osource "E:/Code_Projects/zephyr/soc/intel/intel_ish/Kconfig.sysbuild"
osource "E:/Code_Projects/zephyr/soc/intel/intel_adsp/Kconfig.sysbuild"
osource "E:/Code_Projects/zephyr/soc/intel/elkhart_lake/Kconfig.sysbuild"
osource "E:/Code_Projects/zephyr/soc/intel/atom/Kconfig.sysbuild"
osource "E:/Code_Projects/zephyr/soc/intel/apollo_lake/Kconfig.sysbuild"
osource "E:/Code_Projects/zephyr/soc/intel/alder_lake/Kconfig.sysbuild"
osource "E:/Code_Projects/zephyr/soc/infineon/cat3/Kconfig.sysbuild"
osource "E:/Code_Projects/zephyr/soc/infineon/cat1c/Kconfig.sysbuild"
osource "E:/Code_Projects/zephyr/soc/infineon/cat1b/Kconfig.sysbuild"
osource "E:/Code_Projects/zephyr/soc/infineon/cat1a/Kconfig.sysbuild"
osource "E:/Code_Projects/zephyr/soc/gd/gd32/Kconfig.sysbuild"
osource "E:/Code_Projects/zephyr/soc/gaisler/leon3/Kconfig.sysbuild"
osource "E:/Code_Projects/zephyr/soc/gaisler/gr716a/Kconfig.sysbuild"
osource "E:/Code_Projects/zephyr/soc/espressif/Kconfig.sysbuild"
osource "E:/Code_Projects/zephyr/soc/ene/kb1200/Kconfig.sysbuild"
osource "E:/Code_Projects/zephyr/soc/efinix/sapphire/Kconfig.sysbuild"
osource "E:/Code_Projects/zephyr/soc/cdns/xtensa_sample_controller/Kconfig.sysbuild"
osource "E:/Code_Projects/zephyr/soc/cdns/sample_controller32/Kconfig.sysbuild"
osource "E:/Code_Projects/zephyr/soc/cdns/dc233c/Kconfig.sysbuild"
osource "E:/Code_Projects/zephyr/soc/brcm/bcmvk/Kconfig.sysbuild"
osource "E:/Code_Projects/zephyr/soc/brcm/bcm2712/Kconfig.sysbuild"
osource "E:/Code_Projects/zephyr/soc/brcm/bcm2711/Kconfig.sysbuild"
osource "E:/Code_Projects/zephyr/soc/bflb/Kconfig.sysbuild"
osource "E:/Code_Projects/zephyr/soc/atmel/sam0/Kconfig.sysbuild"
osource "E:/Code_Projects/zephyr/soc/atmel/sam/Kconfig.sysbuild"
osource "E:/Code_Projects/zephyr/soc/aspeed/Kconfig.sysbuild"
osource "E:/Code_Projects/zephyr/soc/arm/Kconfig.sysbuild"
osource "E:/Code_Projects/zephyr/soc/arm/beetle/Kconfig.sysbuild"
osource "E:/Code_Projects/zephyr/soc/antmicro/myra/Kconfig.sysbuild"
osource "E:/Code_Projects/zephyr/soc/andestech/Kconfig.sysbuild"
osource "E:/Code_Projects/zephyr/soc/amd/acp_6_0/Kconfig.sysbuild"
osource "E:/Code_Projects/zephyr/soc/ambiq/Kconfig.sysbuild"
osource "E:/Code_Projects/zephyr/soc/aesc/Kconfig.sysbuild"
osource "E:/Code_Projects/zephyr/soc/adi/max32/Kconfig.sysbuild"
osource "E:/Code_Projects/nrf/soc/sercomm/nrf91/Kconfig.sysbuild"
osource "E:/Code_Projects/nrf/soc/nordic/Kconfig.sysbuild"
```
