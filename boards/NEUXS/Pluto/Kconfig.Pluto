## boards/NEUXS/Pluto/Pluto_defconfig
```kconfig
CONFIG_ARM_MPU=y
CONFIG_HW_STACK_PROTECTION=y

CONFIG_SENSOR_USE_MAG=y
CONFIG_LED_RGB_COLOR=y
CONFIG_BATTERY_USE_REG_LDO_MAPPING=y

CONFIG_USB_DEVICE_STACK=y
CONFIG_USB_DEVICE_MANUFACTURER="Pluto"
CONFIG_USB_DEVICE_PRODUCT="Pluto Slime-smol"

# ==========================================
#  Bootloader 内存偏移与固件生成
# ==========================================
# 如果你的芯片里【已经】通过 SWD 刷入了 Adafruit nRF52 Bootloader：
# 请保持下面两行开启，编译后会生成 .uf2 文件供拖拽升级。
# 
# 如果你使用的是刚从工厂拿回来的【全空芯片】，且每次都用下载器烧录：
# 请务必在下面两行前面加 # 号把它们注释掉，否则板子无法启动！
#CONFIG_BUILD_OUTPUT_UF2=y
#CONFIG_FLASH_LOAD_OFFSET=0x1000
```

## test/Kconfig/Kconfig.modules
```kconfig
menu "nrf (E:/Code_Projects/nrf)"
osource "E:/Code_Projects/nrf/Kconfig.nrf"
config ZEPHYR_NRF_MODULE
	bool
	default y
endmenu
menu "hostap (E:/Code_Projects/modules/lib/hostap)"
osource "$(ZEPHYR_HOSTAP_KCONFIG)"
config ZEPHYR_HOSTAP_MODULE
	bool
	default y
endmenu
menu "mcuboot (E:/Code_Projects/bootloader/mcuboot)"
osource "$(ZEPHYR_MCUBOOT_KCONFIG)"
config ZEPHYR_MCUBOOT_MODULE
	bool
	default y
endmenu
menu "mbedtls (E:/Code_Projects/modules/crypto/mbedtls)"
osource "$(ZEPHYR_MBEDTLS_KCONFIG)"
config ZEPHYR_MBEDTLS_MODULE
	bool
	default y
endmenu
menu "oberon-psa-crypto (E:/Code_Projects/modules/crypto/oberon-psa-crypto)"
osource "E:/Code_Projects/modules/crypto/oberon-psa-crypto/Kconfig.oberon_psa_crypto"
config ZEPHYR_OBERON_PSA_CRYPTO_MODULE
	bool
	default y
endmenu
menu "trusted-firmware-m (E:/Code_Projects/modules/tee/tf-m/trusted-firmware-m)"
osource "$(ZEPHYR_TRUSTED_FIRMWARE_M_KCONFIG)"
config ZEPHYR_TRUSTED_FIRMWARE_M_MODULE
	bool
	default y
endmenu
config ZEPHYR_PSA_ARCH_TESTS_MODULE
	bool
	default y
menu "cjson (E:/Code_Projects/modules/lib/cjson)"
osource "$(ZEPHYR_CJSON_KCONFIG)"
config ZEPHYR_CJSON_MODULE
	bool
	default y
endmenu
menu "azure-sdk-for-c (E:/Code_Projects/modules/lib/azure-sdk-for-c)"
osource "$(ZEPHYR_AZURE_SDK_FOR_C_KCONFIG)"
config ZEPHYR_AZURE_SDK_FOR_C_MODULE
	bool
	default y
endmenu
menu "cirrus-logic (E:/Code_Projects/modules/hal/cirrus-logic)"
osource "E:/Code_Projects/modules/hal/cirrus-logic/Kconfig"
config ZEPHYR_CIRRUS_LOGIC_MODULE
	bool
	default y
endmenu
menu "openthread (E:/Code_Projects/modules/lib/openthread)"
osource "$(ZEPHYR_OPENTHREAD_KCONFIG)"
config ZEPHYR_OPENTHREAD_MODULE
	bool
	default y
endmenu
menu "memfault-firmware-sdk (E:/Code_Projects/modules/lib/memfault-firmware-sdk)"
osource "E:/Code_Projects/modules/lib/memfault-firmware-sdk/ports/zephyr/Kconfig"
config ZEPHYR_MEMFAULT_FIRMWARE_SDK_MODULE
	bool
	default y
endmenu
menu "coremark (E:/Code_Projects/modules/benchmark/coremark)"
osource "$(ZEPHYR_COREMARK_KCONFIG)"
config ZEPHYR_COREMARK_MODULE
	bool
	default y
endmenu
menu "canopennode (E:/Code_Projects/modules/lib/canopennode)"
osource "$(ZEPHYR_CANOPENNODE_KCONFIG)"
config ZEPHYR_CANOPENNODE_MODULE
	bool
	default y
endmenu
menu "chre (E:/Code_Projects/modules/lib/chre)"
osource "E:/Code_Projects/modules/lib/chre/platform/zephyr/Kconfig"
config ZEPHYR_CHRE_MODULE
	bool
	default y
endmenu
menu "lz4 (E:/Code_Projects/modules/lib/lz4)"
osource "$(ZEPHYR_LZ4_KCONFIG)"
config ZEPHYR_LZ4_MODULE
	bool
	default y
endmenu
menu "nanopb (E:/Code_Projects/modules/lib/nanopb)"
osource "$(ZEPHYR_NANOPB_KCONFIG)"
config ZEPHYR_NANOPB_MODULE
	bool
	default y
endmenu
config ZEPHYR_TF_M_TESTS_MODULE
	bool
	default y
menu "zscilib (E:/Code_Projects/modules/lib/zscilib)"
osource "E:/Code_Projects/modules/lib/zscilib/Kconfig.zscilib"
config ZEPHYR_ZSCILIB_MODULE
	bool
	default y
endmenu
menu "cmsis (E:/Code_Projects/modules/hal/cmsis)"
osource "$(ZEPHYR_CMSIS_KCONFIG)"
config ZEPHYR_CMSIS_MODULE
	bool
	default y
endmenu
menu "cmsis-dsp (E:/Code_Projects/modules/lib/cmsis-dsp)"
osource "$(ZEPHYR_CMSIS_DSP_KCONFIG)"
config ZEPHYR_CMSIS_DSP_MODULE
	bool
	default y
endmenu
menu "cmsis-nn (E:/Code_Projects/modules/lib/cmsis-nn)"
osource "$(ZEPHYR_CMSIS_NN_KCONFIG)"
config ZEPHYR_CMSIS_NN_MODULE
	bool
	default y
endmenu
menu "cmsis_6 (E:/Code_Projects/modules/hal/cmsis_6)"
osource "$(ZEPHYR_CMSIS_6_KCONFIG)"
config ZEPHYR_CMSIS_6_MODULE
	bool
	default y
endmenu
menu "fatfs (E:/Code_Projects/modules/fs/fatfs)"
osource "$(ZEPHYR_FATFS_KCONFIG)"
config ZEPHYR_FATFS_MODULE
	bool
	default y
endmenu
menu "hal_nordic (E:/Code_Projects/modules/hal/nordic)"
osource "$(ZEPHYR_HAL_NORDIC_KCONFIG)"
config ZEPHYR_HAL_NORDIC_MODULE
	bool
	default y

config ZEPHYR_HAL_NORDIC_MODULE_BLOBS
	bool
endmenu
menu "hal_st (E:/Code_Projects/modules/hal/st)"
osource "$(ZEPHYR_HAL_ST_KCONFIG)"
config ZEPHYR_HAL_ST_MODULE
	bool
	default y
endmenu
menu "hal_tdk (E:/Code_Projects/modules/hal/tdk)"
osource "$(ZEPHYR_HAL_TDK_KCONFIG)"
config ZEPHYR_HAL_TDK_MODULE
	bool
	default y
endmenu
config ZEPHYR_HAL_WURTHELEKTRONIK_MODULE
	bool
	default y
menu "liblc3 (E:/Code_Projects/modules/lib/liblc3)"
osource "$(ZEPHYR_LIBLC3_KCONFIG)"
config ZEPHYR_LIBLC3_MODULE
	bool
	default y
endmenu
config ZEPHYR_LIBMETAL_MODULE
	bool
	default y
menu "littlefs (E:/Code_Projects/modules/fs/littlefs)"
osource "$(ZEPHYR_LITTLEFS_KCONFIG)"
config ZEPHYR_LITTLEFS_MODULE
	bool
	default y
endmenu
menu "loramac-node (E:/Code_Projects/modules/lib/loramac-node)"
osource "$(ZEPHYR_LORAMAC_NODE_KCONFIG)"
config ZEPHYR_LORAMAC_NODE_MODULE
	bool
	default y
endmenu
menu "lvgl (E:/Code_Projects/modules/lib/gui/lvgl)"
osource "E:/Code_Projects/modules/lib/gui/lvgl/zephyr/Kconfig"
config ZEPHYR_LVGL_MODULE
	bool
	default y
endmenu
config ZEPHYR_MIPI_SYS_T_MODULE
	bool
	default y
menu "nrf_wifi (E:/Code_Projects/modules/lib/nrf_wifi)"
osource "$(ZEPHYR_NRF_WIFI_KCONFIG)"
config ZEPHYR_NRF_WIFI_MODULE
	bool
	default y

config ZEPHYR_NRF_WIFI_MODULE_BLOBS
	bool
endmenu
config ZEPHYR_OPEN_AMP_MODULE
	bool
	default y
menu "percepio (E:/Code_Projects/modules/debug/percepio)"
osource "E:/Code_Projects/modules/debug/percepio/zephyr/Kconfig"
config ZEPHYR_PERCEPIO_MODULE
	bool
	default y
endmenu
menu "picolibc (E:/Code_Projects/modules/lib/picolibc)"
osource "E:/Code_Projects/modules/lib/picolibc/zephyr/Kconfig"
config ZEPHYR_PICOLIBC_MODULE
	bool
	default y
endmenu
menu "segger (E:/Code_Projects/modules/debug/segger)"
osource "$(ZEPHYR_SEGGER_KCONFIG)"
config ZEPHYR_SEGGER_MODULE
	bool
	default y
endmenu
config ZEPHYR_TINYCRYPT_MODULE
	bool
	default y
menu "uoscore-uedhoc (E:/Code_Projects/modules/lib/uoscore-uedhoc)"
osource "$(ZEPHYR_UOSCORE_UEDHOC_KCONFIG)"
config ZEPHYR_UOSCORE_UEDHOC_MODULE
	bool
	default y
endmenu
menu "zcbor (E:/Code_Projects/modules/lib/zcbor)"
osource "$(ZEPHYR_ZCBOR_KCONFIG)"
config ZEPHYR_ZCBOR_MODULE
	bool
	default y
endmenu
menu "nrfxlib (E:/Code_Projects/nrfxlib)"
osource "E:/Code_Projects/nrfxlib/Kconfig.nrfxlib"
config ZEPHYR_NRFXLIB_MODULE
	bool
	default y
endmenu
config ZEPHYR_NRF_HW_MODELS_MODULE
	bool
	default y
menu "connectedhomeip (E:/Code_Projects/modules/lib/matter)"
osource "E:/Code_Projects/modules/lib/matter/config/nrfconnect/chip-module/Kconfig"
config ZEPHYR_CONNECTEDHOMEIP_MODULE
	bool
	default y
endmenu
```

## test/Kconfig/Kconfig.shield
```kconfig
osource "E:/Code_Projects/SlimeVR-Tracker-nRF-52833/boards/shields/*/Kconfig.shield"
osource "E:/Code_Projects/nrf/boards/shields/*/Kconfig.shield"
```

## test/Kconfig/arch/Kconfig
```kconfig
# Load Zephyr Arch Kconfig descriptions.
osource "E:/Code_Projects/zephyr/arch/rx/Kconfig"
osource "E:/Code_Projects/zephyr/arch/x86/Kconfig"
osource "E:/Code_Projects/zephyr/arch/xtensa/Kconfig"
osource "E:/Code_Projects/zephyr/arch/sparc/Kconfig"
osource "E:/Code_Projects/zephyr/arch/riscv/Kconfig"
osource "E:/Code_Projects/zephyr/arch/posix/Kconfig"
osource "E:/Code_Projects/zephyr/arch/mips/Kconfig"
osource "E:/Code_Projects/zephyr/arch/arm64/Kconfig"
osource "E:/Code_Projects/zephyr/arch/arm/Kconfig"
osource "E:/Code_Projects/zephyr/arch/arc/Kconfig"
```

## test/Kconfig/boards/Kconfig.Pluto
```kconfig
# Load board Kconfig descriptions.
osource "E:/Code_Projects/SlimeVR-Tracker-nRF-52833/boards/NEUXS/Pluto/Kconfig.Pluto"
```

## test/Kconfig/boards/Kconfig.defconfig
```kconfig
# Load Zephyr board defconfig descriptions.
osource "E:/Code_Projects/SlimeVR-Tracker-nRF-52833/boards/NEUXS/Pluto/Kconfig.defconfig"
```

## test/Kconfig/soc/Kconfig
```kconfig
# Load Zephyr SoC Kconfig descriptions.
osource "E:/Code_Projects/zephyr/soc/xlnx/zynqmp/Kconfig"
osource "E:/Code_Projects/zephyr/soc/xlnx/zynq7000/Kconfig"
osource "E:/Code_Projects/zephyr/soc/xlnx/versalnet/Kconfig"
osource "E:/Code_Projects/zephyr/soc/xlnx/versal2/Kconfig"
osource "E:/Code_Projects/zephyr/soc/xen/Kconfig"
osource "E:/Code_Projects/zephyr/soc/wch/ch32v/Kconfig"
osource "E:/Code_Projects/zephyr/soc/ti/simplelink/Kconfig"
osource "E:/Code_Projects/zephyr/soc/ti/mspm0/Kconfig"
osource "E:/Code_Projects/zephyr/soc/ti/lm3s6965/Kconfig"
osource "E:/Code_Projects/zephyr/soc/ti/k3/Kconfig"
osource "E:/Code_Projects/zephyr/soc/telink/tlsr/Kconfig"
osource "E:/Code_Projects/zephyr/soc/starfive/jh71xx/Kconfig"
osource "E:/Code_Projects/zephyr/soc/st/stm32/Kconfig"
osource "E:/Code_Projects/zephyr/soc/snps/qemu_arc/Kconfig"
osource "E:/Code_Projects/zephyr/soc/snps/nsim/arc_v/Kconfig"
osource "E:/Code_Projects/zephyr/soc/snps/nsim/arc_classic/Kconfig"
osource "E:/Code_Projects/zephyr/soc/snps/hsdk4xd/Kconfig"
osource "E:/Code_Projects/zephyr/soc/snps/hsdk/Kconfig"
osource "E:/Code_Projects/zephyr/soc/snps/emsk/Kconfig"
osource "E:/Code_Projects/zephyr/soc/snps/emsdp/Kconfig"
osource "E:/Code_Projects/zephyr/soc/snps/arc_iot/Kconfig"
osource "E:/Code_Projects/zephyr/soc/silabs/Kconfig"
osource "E:/Code_Projects/zephyr/soc/sifive/sifive_freedom/Kconfig"
osource "E:/Code_Projects/zephyr/soc/sensry/Kconfig"
osource "E:/Code_Projects/zephyr/soc/rockchip/Kconfig"
osource "E:/Code_Projects/zephyr/soc/renode/riscv_virtual/Kconfig"
osource "E:/Code_Projects/zephyr/soc/renode/cortex_r8_virtual/Kconfig"
osource "E:/Code_Projects/zephyr/soc/renesas/smartbond/Kconfig"
osource "E:/Code_Projects/zephyr/soc/renesas/rz/Kconfig"
osource "E:/Code_Projects/zephyr/soc/renesas/rx/Kconfig"
osource "E:/Code_Projects/zephyr/soc/renesas/rcar/Kconfig"
osource "E:/Code_Projects/zephyr/soc/renesas/ra/Kconfig"
osource "E:/Code_Projects/zephyr/soc/realtek/ec/Kconfig"
osource "E:/Code_Projects/zephyr/soc/raspberrypi/rpi_pico/Kconfig"
osource "E:/Code_Projects/zephyr/soc/quicklogic/eos_s3/Kconfig"
osource "E:/Code_Projects/zephyr/soc/qemu/virt_riscv/Kconfig"
osource "E:/Code_Projects/zephyr/soc/qemu/malta/Kconfig"
osource "E:/Code_Projects/zephyr/soc/openisa/rv32m1/Kconfig"
osource "E:/Code_Projects/zephyr/soc/openhwgroup/cva6/Kconfig"
osource "E:/Code_Projects/zephyr/soc/oct/osd32mp15x/Kconfig"
osource "E:/Code_Projects/zephyr/soc/nxp/s32/Kconfig"
osource "E:/Code_Projects/zephyr/soc/nxp/rw/Kconfig"
osource "E:/Code_Projects/zephyr/soc/nxp/mcx/Kconfig"
osource "E:/Code_Projects/zephyr/soc/nxp/lpc/Kconfig"
osource "E:/Code_Projects/zephyr/soc/nxp/layerscape/Kconfig"
osource "E:/Code_Projects/zephyr/soc/nxp/kinetis/Kconfig"
osource "E:/Code_Projects/zephyr/soc/nxp/imxrt/Kconfig"
osource "E:/Code_Projects/zephyr/soc/nxp/imx/Kconfig"
osource "E:/Code_Projects/zephyr/soc/nuvoton/numicro/Kconfig"
osource "E:/Code_Projects/zephyr/soc/nuvoton/numaker/Kconfig"
osource "E:/Code_Projects/zephyr/soc/nuvoton/npcx/Kconfig"
osource "E:/Code_Projects/zephyr/soc/nuvoton/npcm/Kconfig"
osource "E:/Code_Projects/zephyr/soc/nordic/Kconfig"
osource "E:/Code_Projects/zephyr/soc/neorv32/Kconfig"
osource "E:/Code_Projects/zephyr/soc/native/inf_clock/Kconfig"
osource "E:/Code_Projects/zephyr/soc/microchip/sam/Kconfig"
osource "E:/Code_Projects/zephyr/soc/microchip/miv/Kconfig"
osource "E:/Code_Projects/zephyr/soc/microchip/mec/Kconfig"
osource "E:/Code_Projects/zephyr/soc/mediatek/mt8xxx/Kconfig"
osource "E:/Code_Projects/zephyr/soc/lowrisc/opentitan/Kconfig"
osource "E:/Code_Projects/zephyr/soc/litex/litex_vexriscv/Kconfig"
osource "E:/Code_Projects/zephyr/soc/ite/ec/Kconfig"
osource "E:/Code_Projects/zephyr/soc/intel/raptor_lake/Kconfig"
osource "E:/Code_Projects/zephyr/soc/intel/lakemont/Kconfig"
osource "E:/Code_Projects/zephyr/soc/intel/intel_socfpga_std/Kconfig"
osource "E:/Code_Projects/zephyr/soc/intel/intel_socfpga/Kconfig"
osource "E:/Code_Projects/zephyr/soc/intel/intel_niosv/Kconfig"
osource "E:/Code_Projects/zephyr/soc/intel/intel_ish/Kconfig"
osource "E:/Code_Projects/zephyr/soc/intel/intel_adsp/Kconfig"
osource "E:/Code_Projects/zephyr/soc/intel/elkhart_lake/Kconfig"
osource "E:/Code_Projects/zephyr/soc/intel/atom/Kconfig"
osource "E:/Code_Projects/zephyr/soc/intel/apollo_lake/Kconfig"
osource "E:/Code_Projects/zephyr/soc/intel/alder_lake/Kconfig"
osource "E:/Code_Projects/zephyr/soc/infineon/cat3/Kconfig"
osource "E:/Code_Projects/zephyr/soc/infineon/cat1c/Kconfig"
osource "E:/Code_Projects/zephyr/soc/infineon/cat1b/Kconfig"
osource "E:/Code_Projects/zephyr/soc/infineon/cat1a/Kconfig"
osource "E:/Code_Projects/zephyr/soc/gd/gd32/Kconfig"
osource "E:/Code_Projects/zephyr/soc/gaisler/leon3/Kconfig"
osource "E:/Code_Projects/zephyr/soc/gaisler/gr716a/Kconfig"
osource "E:/Code_Projects/zephyr/soc/espressif/Kconfig"
osource "E:/Code_Projects/zephyr/soc/ene/kb1200/Kconfig"
osource "E:/Code_Projects/zephyr/soc/efinix/sapphire/Kconfig"
osource "E:/Code_Projects/zephyr/soc/cdns/xtensa_sample_controller/Kconfig"
osource "E:/Code_Projects/zephyr/soc/cdns/sample_controller32/Kconfig"
osource "E:/Code_Projects/zephyr/soc/cdns/dc233c/Kconfig"
osource "E:/Code_Projects/zephyr/soc/brcm/bcmvk/Kconfig"
osource "E:/Code_Projects/zephyr/soc/brcm/bcm2712/Kconfig"
osource "E:/Code_Projects/zephyr/soc/brcm/bcm2711/Kconfig"
osource "E:/Code_Projects/zephyr/soc/bflb/Kconfig"
osource "E:/Code_Projects/zephyr/soc/atmel/sam0/Kconfig"
osource "E:/Code_Projects/zephyr/soc/atmel/sam/Kconfig"
osource "E:/Code_Projects/zephyr/soc/aspeed/Kconfig"
osource "E:/Code_Projects/zephyr/soc/arm/Kconfig"
osource "E:/Code_Projects/zephyr/soc/arm/beetle/Kconfig"
osource "E:/Code_Projects/zephyr/soc/antmicro/myra/Kconfig"
osource "E:/Code_Projects/zephyr/soc/andestech/Kconfig"
osource "E:/Code_Projects/zephyr/soc/amd/acp_6_0/Kconfig"
osource "E:/Code_Projects/zephyr/soc/ambiq/Kconfig"
osource "E:/Code_Projects/zephyr/soc/aesc/Kconfig"
osource "E:/Code_Projects/zephyr/soc/adi/max32/Kconfig"
osource "E:/Code_Projects/nrf/soc/sercomm/nrf91/Kconfig"
osource "E:/Code_Projects/nrf/soc/nordic/Kconfig"
```
